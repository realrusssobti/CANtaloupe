VERSION ""

NS_ :

BS_:

BO_ 0 bazinga: 69 Vector__XXX
 SG_ Signal1 : 0|8@0+ (1,0) [0|0] "None" Vector_XXX
 SG_ Signal1 : 0|8@0+ (1,0) [0|0] "None" Vector_XXX
